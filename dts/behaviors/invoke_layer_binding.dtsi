#include <dt-bindings/zmk/behaviors.h>
#include <dt-bindings/zmk/keys.h>

/ {
    behaviors {
        layer: invoke_layer_binding {
            compatible = "zmk,behavior-invoke-layer-binding";
            #binding-cells = <2>;
        };
    };
};