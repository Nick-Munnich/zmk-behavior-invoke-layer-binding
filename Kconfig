## Kconfig
```kconfig
DT_COMPAT_ZMK_BEHAVIOR_INVOKE_LAYER_BINDING := zmk,behavior-invoke-layer-binding

config ZMK_BEHAVIOR_INVOKE_LAYER_BINDING
    bool
    default $(dt_compat_enabled,$(DT_COMPAT_ZMK_BEHAVIOR_AUTO_LAYER))
```

## dts/bindings/behaviors/zmk,behavior-invoke-layer-binding.yaml
```yaml
description: Invokes a binding from a layer

compatible: "zmk,behavior-invoke-layer-binding"

include: two_param.yaml
```
